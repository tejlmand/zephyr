## boards/v2/nordic_nrf/nrf51dk/Kconfig.nrf51dk
```kconfig
# Copyright (c) 2023 Nordic Semiconductor ASA

# SPDX-License-Identifier: Apache-2.0

config BOARD_NRF51DK
	bool
	default y
	select SOC_SERIES_NRF51X
	select SOC_NRF51822_QFAC
```

## boards/v2/nordic_nrf/nrf52833dk/Kconfig.nrf52833dk
```kconfig
# nRF52833 DK NRF52833 board configuration

# Copyright (c) 2019 Nordic Semiconductor ASA
# SPDX-License-Identifier: Apache-2.0

config BOARD_NRF52833DK
	bool
	default y
	select SOC_SERIES_NRF52X
	select SOC_NRF52820_QDAA if $(BOARD_IDENTIFIER) = "/nrf52820"
	select SOC_NRF52833_QIAA if $(BOARD_IDENTIFIER) = "/nrf52833"
```

## boards/v2/nordic_nrf/nrf52dk/Kconfig.nrf52dk
```kconfig
# nRF52 DK nRF52810 board configuration

# Copyright (c) 2018 Nordic Semiconductor ASA
# SPDX-License-Identifier: Apache-2.0

config BOARD_NRF52DK
	bool
	default y
	select SOC_SERIES_NRF52X
	select SOC_NRF52805_CAAA if $(BOARD_IDENTIFIER) = "/nrf52805"
	select SOC_NRF52810_QFAA if $(BOARD_IDENTIFIER) = "/nrf52810"
	select SOC_NRF52832_QFAA if $(BOARD_IDENTIFIER) = "/nrf52832"
```

## boards/v2/nordic_nrf/nrf5340_audio_dk/Kconfig.nrf5340_audio_dk
```kconfig
# nRF5340 Audio DK board configuration

# Copyright (c) 2019 Nordic Semiconductor ASA
# SPDX-License-Identifier: Apache-2.0

config BOARD_NRF5340_AUDIO_DK
	select SOC_NRF5340_CPUAPP_QKAA if "$(BOARD_IDENTIFIER)" = "/nrf5340/cpuapp"
	select SOC_NRF5340_CPUAPP_QKAA if "$(BOARD_IDENTIFIER)" = "/nrf5340/cpuapp/ns"
	select SOC_NRF5340_CPUNET_QKAA if "$(BOARD_IDENTIFIER)" = "/nrf5340/cpunet"
```

## boards/v2/nordic_nrf/nrf5340dk_nrf5340/board.yml
```yaml
board:
  name: nrf5340dk_nrf5340
  vendor: Nordic Semiconductor
  arch: arm
  revision:
    format: fuzzy
    default: 0.1.2
    revisions:
      - name: 0.1.2
  cpuset:
  - 'cpuapp'
  - 'cpuapp_ns'
  - 'cpunet'
```

## boards/v2/nordic_nrf/thingy53/Kconfig.thingy53
```kconfig
# Thingy53 NRF5340 board configuration

# Copyright (c) 2021 Nordic Semiconductor ASA
# SPDX-License-Identifier: Apache-2.0

config BOARD_THINGY53
	select SOC_NRF5340_CPUAPP_QKAA if "$(BOARD_IDENTIFIER)" = "/nrf5340/cpuapp"
	select SOC_NRF5340_CPUAPP_QKAA if "$(BOARD_IDENTIFIER)" = "/nrf5340/cpuapp/ns"
	select SOC_NRF5340_CPUNET_QKAA if "$(BOARD_IDENTIFIER)" = "/nrf5340/cpunet"
```

## boards/v2/raytac/raytac_mdbt53v_db_40/Kconfig.raytac_mdbt53v_db_40
```kconfig
# Raytac MDBT53-DB-40 NRF5340 board configuration

# Copyright (c) 2019-2020 Nordic Semiconductor ASA
# SPDX-License-Identifier: Apache-2.0

config BOARD_RAYTAC_MDBT53V_DB_40
	select SOC_NRF5340_CPUAPP_QKAA if "$(BOARD_IDENTIFIER)" = "/nrf5340/cpuapp"
	select SOC_NRF5340_CPUAPP_QKAA if "$(BOARD_IDENTIFIER)" = "/nrf5340/cpuapp/ns"
	select SOC_NRF5340_CPUNET_QKAA if "$(BOARD_IDENTIFIER)" = "/nrf5340/cpunet"
```

## modules/Kconfig.tfm
```kconfig
# TF-M/PSA Related

# Copyright (c) 2019, 2020 Linaro Limited
# SPDX-License-Identifier: Apache-2.0

config BUILD_WITH_TFM
	bool "Build with TF-M for Secure Execution"

config PSA_ARCH_TEST_SUITE
	string "PSA arch API test suite"
	default "ipc"
	help
	  Indicates which test suite(s) will be run.
	  Support: ipc, crypto, protected_storage, internal_trusted_storage, initial_attestation
```

## samples/subsys/ipc/openamp/Kconfig.sysbuild
```kconfig
# Copyright (c) 2021 Nordic Semiconductor
#
# SPDX-License-Identifier: Apache-2.0

source "sysbuild/Kconfig"

config SB_OPENAMP_REMOTE
	bool "Openamp remote sample"
	default y if BOARD_openamp_remote != ""

config SB_BOARD_openamp_remote
	string
	# Note: the lpc boards uses generate_inc_file_for_gen_target() to embed
	#       the second image into the first. This is not supported in initial
	#       multi image approach.
	default "lpcxpresso54114_m0" if $(BOARD) = "lpcxpresso54114_m4"
	default "lpcxpresso55s69_cpu1"if $(BOARD) = "lpcxpresso55s69_cpu0"
	default "mps2_an521_remote" if $(BOARD) = "mps2_an521"
	default "v2m_musca_b1_ns" if $(BOARD) = "v2m_musca_b1"

config SB_BOARD_USER_DEFINED_openamp_remote
	string "Remote board for openamp sample"
	depends on BOARD_openamp_remote = ""
```
