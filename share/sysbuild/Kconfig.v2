## tests/bluetooth/host/buf/bt_buf_get_cmd_complete/testcase.yaml
```yaml
common:
    tags: test_framework bluetooth host
tests:
  bluetooth.host.bt_buf_get_cmd_complete.default:
     type: unit
  bluetooth.host.bt_buf_get_cmd_complete.hci_acl_flow_control:
     type: unit
     # enable CONFIG_BT_HCI_ACL_FLOW_CONTROL
     extra_configs:
      - CONFIG_BT_CENTRAL=y
  bluetooth.host.bt_buf_get_cmd_complete.iso_unicast:
     type: unit
     # enable CONFIG_BT_ISO_UNICAST
     extra_configs:
      - CONFIG_BT_ISO_CENTRAL=y
  bluetooth.host.bt_buf_get_cmd_complete.iso_sync_receiver:
     type: unit
     # enable CONFIG_BT_ISO_SYNC_RECEIVER
     extra_configs:
      - CONFIG_BT_ISO_SYNC_RECEIVER=y
```

## tests/kernel/condvar/condvar_api/testcase.yaml
```yaml
tests:
  kernel.condvar:
    tags: kernel userspace condition_variables ignore_faults
  kernel.condvar.linker_generator:
    arch_allow: arm
    tags: kernel userspace condition_variables ignore_faults linker_generator
    extra_configs:
      - CONFIG_CMAKE_LINKER_GENERATOR=y
```
