## share/sysbuild/Kconfig.v2
```kconfig
# Copyright (c) 2023 Nordic Semiconductor
#
# SPDX-License-Identifier: Apache-2.0

config BOARD
	string
	default "$(BOARD)"
	help
	  This option holds the name of the board and is used to locate the files
	  related to the board in the source tree (under boards/).
	  The Board is the first location where we search for a linker.ld file,
	  if not found we look for the linker file in
	  soc/<arch>/<family>/<series>

config BOARD_REVISION
	def_string "$BOARD_REVISION"
	help
	  If the BOARD has a revision field set, this is the revision.
	  Otherwise, it is the empty string. For example, if BOARD is
	  "plank@foo", this option will be "foo". If BOARD is "plank",
	  this option will be the empty string.

config BOARD_DEPRECATED_RELEASE
	string
	help
	  This hidden option is set in the board configuration and indicates
	  the Zephyr release that the board configuration will be removed.
	  When set, any build for that board will generate a clearly visible
	  deprecation warning.

source "boards/Kconfig.$(HWM_SCHEME)"

config SOC
	string
	help
	  SoC name which can be found under soc/<arch>/<soc name>.
	  This option holds the directory name used by the build system to locate
	  the correct linker and header files for the SoC.

config SOC_SERIES
	string
	help
	  SoC series name which can be found under soc/<arch>/<family>/<series>.
	  This option holds the directory name used by the build system to locate
	  the correct linker and header files.

config SOC_FAMILY
	string
	help
	  SoC family name which can be found under soc/<arch>/<family>.
	  This option holds the directory name used by the build system to locate
	  the correct linker and header files.

# Source all Kconfig HWMv2 from SoC roots.
source "$(KCONFIG_BINARY_DIR)/Kconfig.soc"
```

## soc/Kconfig.soc
```kconfig
# Copyright (c) 2024 Nordic Semiconductor ASA

# SPDX-License-Identifier: Apache-2.0

# Convert list of SoCs into Kconfig settings

SOC := $(get,$(SOCS),0)
SOC_UPPER := $(sanitize_upper,$(SOC))
SOCS := $(remove,$(SOCS),$(SOC))

config SOC_$(SOC_UPPER)
	bool
	select SOC_SERIES_$(defined,$($(SOC)_SERIES),$(sanitize_upper,$($(SOC)_SERIES)),NONE)
	select SOC_FAMILY_$(defined,$($(SOC)_FAMILY),$(sanitize_upper,$($(SOC)_FAMILY)),NONE)

config SOC
	default "$(SOC)" if SOC_$(SOC_UPPER)

RECURSIVE_SOURCE := ./$(RECURSIVE_SOURCE)
source "$(defined,$(SOCS),soc/$(RECURSIVE_SOURCE)Kconfig.soc,misc/Kconfig.empty)"
```

## soc/Kconfig.soc.family
```kconfig
# Copyright (c) 2024 Nordic Semiconductor ASA

# SPDX-License-Identifier: Apache-2.0

# Convert list of SoCs into Kconfig settings

FAMILY := $(get,$(SOC_FAMILIES),0)
FAMILY_UPPER := $(sanitize_upper,$(FAMILY))
SOC_FAMILIES := $(remove,$(SOC_FAMILIES),$(FAMILY))

config SOC_FAMILY_$(FAMILY_UPPER)
	bool

config SOC_FAMILY
	default "$(FAMILY)" if SOC_FAMILY_$(FAMILY_UPPER)

RECURSIVE_SOURCE := ./$(RECURSIVE_SOURCE)
source "$(defined,$(SOC_FAMILIES),soc/$(RECURSIVE_SOURCE)Kconfig.soc.family,misc/Kconfig.empty)"
```

## soc/Kconfig.soc.select
```kconfig
SERIES_UPPER := $(sanitize_upper,$($(SOC)_SERIES))

config SOC_$(SOC_UPPER)
	select SOC_SERIES_$(SERIES_UPPER)
```

## soc/Kconfig.soc.series
```kconfig
# Copyright (c) 2024 Nordic Semiconductor ASA

# SPDX-License-Identifier: Apache-2.0

# Convert list of SoCs into Kconfig settings

SERIES := $(get,$(SOC_SERIES),0)
SERIES_UPPER := $(sanitize_upper,$(SERIES))
SOC_SERIES := $(remove,$(SOC_SERIES),$(SERIES))

config SOC_SERIES_$(SERIES_UPPER)
	bool
	
config SOC_SERIES
	default "$(SERIES)" if SOC_SERIES_$(SERIES_UPPER)

RECURSIVE_SOURCE := ./$(RECURSIVE_SOURCE)
source "$(defined,$(SOC_SERIES),soc/$(RECURSIVE_SOURCE)Kconfig.soc.series,misc/Kconfig.empty)"
```

## soc/Kconfig.soc.v2
```kconfig
# Copyright (c) 2023 Nordic Semiconductor ASA
# SPDX-License-Identifier: Apache-2.0

# This file is loaded through the generated SoC Kconfig for hw model v2.
#
# The purpose of this file is to load generic hw model v2 SoC descriptions.
# The tree loaded below is required to be self-contained, and must not contain
# any Kconfig references (select, depends on, if, etc) outside the tree itself.
#
# The tree is re-usable outside the Zephyr Kconfig tree, and can be re-used in
# other Kconfig trees, for example the sysbuild Kconfig tree.

# To include a new SoC HWMv2, add a line referencing the Kconfig, like this
# source "soc/v2/<vendor|name|other>/Kconfig.soc.v2"
source "soc/v2/nordic_nrf/Kconfig.soc.v2"
```

## soc/Kconfig.v1
```kconfig
# Copyright (c) 2022 Nordic Semiconductor ASA

# SPDX-License-Identifier: Apache-2.0

config SOC
	string
	help
	  SoC name which can be found under soc/<arch>/<soc name>.
	  This option holds the directory name used by the build system to locate
	  the correct linker and header files for the SoC.

config SOC_SERIES
	string
	help
	  SoC series name which can be found under soc/<arch>/<family>/<series>.
	  This option holds the directory name used by the build system to locate
	  the correct linker and header files.

config SOC_FAMILY
	string
	help
	  SoC family name which can be found under soc/<arch>/<family>.
	  This option holds the directory name used by the build system to locate
	  the correct linker and header files.

choice
	prompt "SoC/CPU/Configuration Selection"

# This loads custom SoC root Kconfig (only available if custom SoC root are defined)
osource "$(KCONFIG_BINARY_DIR)/Kconfig.soc"
# This loads Zephyr base SoC scheme v1 root Kconfig
osource "soc/$(ARCH)/*/Kconfig.soc"

endchoice

menu "Hardware Configuration"
# This loads custom SoC root Kconfig (only available if custom SoC root are defined)
osource "$(KCONFIG_BINARY_DIR)/Kconfig.soc.arch"
# This loads Zephyr base SoC Kconfigs
osource "soc/$(ARCH)/Kconfig"
osource "soc/$(ARCH)/*/Kconfig"

module = SOC
module-str = SOC
source "subsys/logging/Kconfig.template.log_config"

endmenu

# The helper symbols below are put here due to an unusual setup: The simulated
# nrf52_bsim board uses the POSIX arch, but is compatible with Nordic ARM
# boards

config SOC_COMPATIBLE_NRF
	bool

config SOC_COMPATIBLE_NRF52X
	bool

config SOC_COMPATIBLE_NRF53X
	bool

config SOC_COMPATIBLE_NRF52833
	bool

config SOC_COMPATIBLE_NRF5340_CPUNET
	bool

config SOC_COMPATIBLE_NRF5340_CPUAPP
	bool

config SOC_DEPRECATED_RELEASE
	string
	help
	  This hidden option is set in the SoC configuration and indicates
	  the Zephyr release that the SoC configuration will be removed.
	  When set, any build for that SoC will generate a clearly visible
	  deprecation warning.

config SOC_HAS_TIMING_FUNCTIONS
	bool
	help
	  Should be selected if SoC provides custom method for retrieving
	  timestamps and cycle count.

config SOC_HAS_RUNTIME_NUM_CPUS
	bool
	help
	  Should be selected if SoC handles determining the number of CPUs
	  at runtime.
```

## soc/Kconfig.zephyr.defconfig.v2
```kconfig
# Copyright (c) 2023 Nordic Semiconductor ASA
# SPDX-License-Identifier: Apache-2.0

# This file is loaded through the generated Zephyr SoC Kconfig defconfig for hw model v2.
#
# The purpose of this file is to adjust Zephyr specific defaults for hw model v2
# SoC descriptions.

# To include a new SoC HWMv2 containing Zephyr specific defconfigs, add a line
# referencing the Kconfig.defconfig, like this
# source "soc/v2/<vendor|name|other>/Kconfig.zephyr.defconfig"
source "soc/v2/nordic_nrf/Kconfig.zephyr.defconfig"
```

## soc/Kconfig.zephyr.v2
```kconfig
# Copyright (c) 2023 Nordic Semiconductor ASA
# SPDX-License-Identifier: Apache-2.0

# This file is loaded through the generated Zephyr SoC Kconfig for hw model v2.
#
# The purpose of this file is to Zephyr specific hw model v2 SoC descriptions.
# The tree loaded below is integrated part of the Zephyr Kconfig tree and can
# therefore contain Kconfig references (select, depends on, if, etc) to any
# symbol in the Zephyr Kconfig tree.
# This means that if a generic SoC symbol is defined in Kconfig.soc.v2 tree,
# then this Kconfig tree can be used to extend such symbol,
# for example in Kconfig.soc.v2 tree:
# config SOC_FOO
#     bool
#     help
#       SoC v2 defined symoutside the tree itself.
#
# can then be extended with Zephyr specifics, like this in Kconfig.zephyr.v2 tree:
# config SOC_FOO
#     select ZEPHYR_BAR
#     help
#       Zephyr extension of SoC v2 defined symbol.
#       This extension ensures the SOC_FOO selects ZEPHYR_BAR when enabled.

# To include a new SoC HWMv2 containing Zephyr specific extensions, add a line
# referencing the Kconfig, like this
# source "soc/v2/<vendor|name|other>/Kconfig.zephyr"
source "soc/sub/v2/nordic_nrf/Kconfig.zephyr"
```

## soc/arm/nordic_nrf/Kconfig.series.v2
```kconfig
# Nordic Semiconductor nRF MCU lines

# Copyright (c) 2022 Nordic Semiconductor ASA
# SPDX-License-Identifier: Apache-2.0

source "soc/arm/nordic_nrf/*/Kconfig.series"
```

## soc/arm/nordic_nrf/nrf52/Kconfig.soc.common
```kconfig
# Nordic Semiconductor nRF52 MCU line, common v1 and v2 file

# Copyright (c) 2016-2019 Nordic Semiconductor ASA
# SPDX-License-Identifier: Apache-2.0

config SOC_NRF52805
	depends on SOC_SERIES_NRF52X
	bool

config SOC_NRF52810
	depends on SOC_SERIES_NRF52X
	bool

config SOC_NRF52811
	depends on SOC_SERIES_NRF52X
	bool

config SOC_NRF52820
	depends on SOC_SERIES_NRF52X
	bool

config SOC_NRF52832
	depends on SOC_SERIES_NRF52X
	bool

config SOC_NRF52833
	depends on SOC_SERIES_NRF52X
	bool

config SOC_NRF52840
	depends on SOC_SERIES_NRF52X
	bool
```

## soc/arm/nordic_nrf/nrf52/Kconfig.soc.v2
```kconfig
# Nordic Semiconductor nRF52 MCU line

# Copyright (c) 2022 Nordic Semiconductor ASA
# SPDX-License-Identifier: Apache-2.0

# This file is SoC scheme v2 compliant, but has been written so that it supports
# SoC scheme v1 also.

config SOC_NRF52805_CAAA
	bool "NRF52805_CAAA" if "$(SOC_SCHEME)" = "v1"
	select SOC_NRF52805

config SOC_NRF52810_QFAA
	bool "NRF52810_QFAA" if "$(SOC_SCHEME)" = "v1"
	select SOC_NRF52810

config SOC_NRF52811_QFAA
	bool "NRF52811_QFAA" if "$(SOC_SCHEME)" = "v1"
	select SOC_NRF52811

config SOC_NRF52820_QDAA
	bool "NRF52820_QDAA" if "$(SOC_SCHEME)" = "v1"
	select SOC_NRF52820

config SOC_NRF52832_CIAA
	bool "NRF52832_CIAA" if "$(SOC_SCHEME)" = "v1"
	select SOC_NRF52832

config SOC_NRF52832_QFAA
	bool "NRF52832_QFAA" if "$(SOC_SCHEME)" = "v1"
	select SOC_NRF52832

config SOC_NRF52832_QFAB
	bool "NRF52832_QFAB" if "$(SOC_SCHEME)" = "v1"
	select SOC_NRF52832

config SOC_NRF52833_QIAA
	bool "NRF52833_QIAA" if "$(SOC_SCHEME)" = "v1"
	select SOC_NRF52833

config SOC_NRF52840_QIAA
	bool "NRF52840_QIAA" if "$(SOC_SCHEME)" = "v1"
	select SOC_NRF52840
```

## soc/nordic_nrf/nrf54h/Kconfig.soc
```kconfig
# Nordic Semiconductor nRF54H MCU line

# Copyright (c) 2024 Nordic Semiconductor ASA
# SPDX-License-Identifier: Apache-2.0

config SOC_SERIES_NRF54HX
	bool
	select SOC_FAMILY_NRF
	help
	  Nordic Semiconductor nRF54H series MCU

config SOC_NRF54H20
	bool
	select SOC_SERIES_NRF54HX
	help
	  nRF54H20

config SOC_NRF54H20_ENGA_CPUAPP
	bool
	select SOC_NRF54H20
	help
	  nRF54H20 ENGA CPUAPP

config SOC_NRF54H20_ENGA_CPURAD
	bool
	select SOC_NRF54H20
	help
	  nRF54H20 ENGA CPURAD

config SOC_NRF54H20_ENGA_CPUPPR
	bool
	select SOC_NRF54H20
	help
	  nRF54H20 ENGA CPUPPR

config SOC_SERIES
	default "nrf54h" if SOC_SERIES_NRF54HX

config SOC
	default "nrf54h20_enga_cpuapp" if SOC_NRF54H20_ENGA_CPUAPP
	default "nrf54h20_enga_cpurad" if SOC_NRF54H20_ENGA_CPURAD
	default "nrf54h20_enga_cpuppr" if SOC_NRF54H20_ENGA_CPUPPR
```

## soc/nordic_nrf/nrf54l/Kconfig.soc
```kconfig
# Nordic Semiconductor nRF54L MCU line

# Copyright (c) 2024 Nordic Semiconductor ASA
# SPDX-License-Identifier: Apache-2.0

config SOC_SERIES_NRF54LX
	bool
	select SOC_FAMILY_NRF
	help
	  Nordic Semiconductor nRF54L series MCU

config SOC_NRF54L15
	bool
	select SOC_SERIES_NRF54LX
	help
	  NRF54L15

config SOC_NRF54L15_ENGA
	bool
	select SOC_NRF54L15
	help
	  NRF54L15 ENGA

config SOC_NRF54L15_ENGA_CPUAPP
	bool
	select SOC_NRF54L15_ENGA
	help
	  NRF54L15 ENGA CPUAPP

config SOC_SERIES
	default "nrf54l" if SOC_SERIES_NRF54LX

config SOC
	default "nrf54l15_enga" if SOC_NRF54L15_ENGA
```

## soc/sub/v2/nordic_nrf/Kconfig.series.v2
```kconfig
# Nordic Semiconductor nRF MCU lines

# Copyright (c) 2022 Nordic Semiconductor ASA
# SPDX-License-Identifier: Apache-2.0

source "soc/sub/v2/nordic_nrf/*/Kconfig.series"
```

## soc/sub/v2/nordic_nrf/nrf52/Kconfig.soc.v1
```kconfig
# Nordic Semiconductor nRF52 MCU line

# Copyright (c) 2022 Nordic Semiconductor ASA
# SPDX-License-Identifier: Apache-2.0

rsource "Kconfig.soc.common"

choice
	prompt "nRF52x MCU Selection"
	depends on SOC_SERIES_NRF52X

# The nordic Kconfig.soc.v2 is scheme v1 compatible, so safe to source here.
rsource "Kconfig.soc.v2"

endchoice

rsource "Kconfig.soc.names"
```

## soc/sub/v2/nordic_nrf/nrf52/Kconfig.soc.v2
```kconfig
# Nordic Semiconductor nRF52 MCU line

# Copyright (c) 2022 Nordic Semiconductor ASA
# SPDX-License-Identifier: Apache-2.0

# This file is SoC scheme v2 compliant, but has been written so that it supports
# SoC scheme v1 also.

config SOC_NRF52805_CAAA
	bool "NRF52805_CAAA" if "$(HWM_SCHEME)" = "v1"
	select SOC_NRF52805

config SOC_NRF52810_QFAA
	bool "NRF52810_QFAA" if "$(HWM_SCHEME)" = "v1"
	select SOC_NRF52810

config SOC_NRF52811_QFAA
	bool "NRF52811_QFAA" if "$(HWM_SCHEME)" = "v1"
	select SOC_NRF52811

config SOC_NRF52820_QDAA
	bool "NRF52820_QDAA" if "$(HWM_SCHEME)" = "v1"
	select SOC_NRF52820

config SOC_NRF52832_CIAA
	bool "NRF52832_CIAA" if "$(HWM_SCHEME)" = "v1"
	select SOC_NRF52832

config SOC_NRF52832_QFAA
	bool "NRF52832_QFAA" if "$(HWM_SCHEME)" = "v1"
	select SOC_NRF52832

config SOC_NRF52832_QFAB
	bool "NRF52832_QFAB" if "$(HWM_SCHEME)" = "v1"
	select SOC_NRF52832

config SOC_NRF52833_QIAA
	bool "NRF52833_QIAA" if "$(HWM_SCHEME)" = "v1"
	select SOC_NRF52833

config SOC_NRF52840_QIAA
	bool "NRF52840_QIAA" if "$(HWM_SCHEME)" = "v1"
	select SOC_NRF52840
```

## soc/v2/nordic_nrf/nrf51/Kconfig.soc.v2
```kconfig
# Nordic Semiconductor nRF51 MCU line

# Copyright (c) 2016 Linaro Limited
# SPDX-License-Identifier: Apache-2.0

config SOC_NRF51822_QFAA
	bool

config SOC_NRF51822_QFAB
	bool

config SOC_NRF51822_QFAC
	bool

config SOC
	default "nRF51822_QFAA"
	depends on SOC_NRF51822_QFAA

config SOC
	default "nRF51822_QFAB"
	depends on SOC_NRF51822_QFAB

config SOC
	default "nRF51822_QFAC"
	depends on SOC_NRF51822_QFAC
```

## soc/v2/nordic_nrf/nrf53/Kconfig.defconfig.series
```kconfig
# Nordic Semiconductor nRF53 MCU line

# Copyright (c) 2019 Nordic Semiconductor ASA
# SPDX-License-Identifier: Apache-2.0

if SOC_SERIES_NRF53X

source "soc/v2/nordic_nrf/nrf53/Kconfig.defconfig.nrf53*"

config SOC_SERIES
	default "nrf53"

endif # SOC_SERIES_NRF53X
```

## sysbuild/Kconfig
```kconfig
# Copyright (c) 2021 Nordic Semiconductor
#
# SPDX-License-Identifier: Apache-2.0

comment "Sysbuild image configuration"

osource "$(BOARD_DIR)/Kconfig.sysbuild"

config WARN_EXPERIMENTAL
	bool
	prompt "Warn on experimental usage"
	help
	  Print a warning when the Kconfig tree is parsed if any experimental
	  features are enabled.

config SUPPORT_BOOTLOADER
	bool
	default y

config SUPPORT_BOOTLOADER_MCUBOOT_ZEPHYR
	bool
	default y

choice BOOTLOADER
	prompt "Bootloader support"
	default BOOTLOADER_NONE
	depends on SUPPORT_BOOTLOADER

config BOOTLOADER_NONE
	bool "None"
	help
	  Do not Include a bootloader in the build

config BOOTLOADER_MCUBOOT
	bool "MCUboot"
	depends on SUPPORT_BOOTLOADER_MCUBOOT_ZEPHYR
	help
	  Include MCUboot (Zephyr port) as the bootloader to use

endchoice
```
