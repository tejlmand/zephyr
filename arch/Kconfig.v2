## arch/Kconfig.v2
```kconfig
# Copyright (c) 2023 Nordic Semiconductor ASA
# SPDX-License-Identifier: Apache-2.0

# ToDo: handle oot archs
source "$(ARCH_DIR)/*/Kconfig"
```

## boards/Kconfig.v1
```kconfig
# SPDX-License-Identifier: Apache-2.0

# Note: $BOARD_DIR might be a glob pattern

choice
	prompt "Board Selection"

source "$(BOARD_DIR)/Kconfig.board"

endchoice
```

## boards/arm/bl5340_dvk/Kconfig.bl5340_dvk_cpuapp
```kconfig
soc = nrf5340_CPUAPP_QKAA

config BOARD_BL5340_DVK_CPUAPP
	bool
	default y
	select SOC_NRF5340_CPUAPP_QKAA
```

## boards/arm/bl5340_dvk/Kconfig.bl5340_dvk_cpunet
```kconfig
soc = nrf5340_CPUNET_QKAA

config BOARD_BL5340_DVK_CPUNET
	bool
	default y
	select SOC_NRF5340_CPUNET_QKAA
```

## boards/arm/bl5340_dvk/bl5340_dvk_cpuapp_defconfig
```kconfig
# SPDX-License-Identifier: Apache-2.0

CONFIG_BOARD_BL5340_DVK_CPUAPP=y
# ^^^ decide what to do with this guy, related to this topic:
# https://github.com/zephyrproject-rtos/zephyr/pull/49260#issuecomment-1220254984
# https://github.com/zephyrproject-rtos/zephyr/pull/49260#issuecomment-1220381626

# Enable MPU
CONFIG_ARM_MPU=y

# Enable hardware stack protection
CONFIG_HW_STACK_PROTECTION=y

# Enable TrustZone-M
CONFIG_ARM_TRUSTZONE_M=y

# Enable GPIO
CONFIG_GPIO=y

# Enable uart driver
CONFIG_SERIAL=y

# Enable console
CONFIG_CONSOLE=y
CONFIG_UART_CONSOLE=y

# Setup clocks
CONFIG_CLOCK_CONTROL_NRF_K32SRC_250PPM=y
CONFIG_SOC_LFXO_CAP_INT_7PF=y
CONFIG_SOC_HFXO_CAP_INTERNAL=y
CONFIG_SOC_HFXO_CAP_INT_VALUE_X2=27

CONFIG_PINCTRL=y
```

## boards/arm/mps2_an521/Kconfig.sysbuild
```kconfig
# Copyright (c) 2021 Nordic Semiconductor
#
# SPDX-License-Identifier: Apache-2.0

config SB_MPS2_AN521_REMOTE
	bool
	default y if $(BOARD) = "mps2_an521_remote"

config SB_MPS2_AN521_EMPTY_CPU0
	bool "Empty cpu0 wakeup sample"
	depends on SB_MPS2_AN521_REMOTE
	default y
	help
	  Building a wakeup firmware image for CPU0.
	  When building firmware for CPU1 then a dedicated binary for CPU0
	  is required which will boot the device and wake up CPU1.
	  Building of empty CPU0 for wakeup of CPU1 can be disabled if a custom
	  image is flashed to CPU0 ensuring correct wakeup of CPU1.
```

## boards/nordic_nrf/nrf54h20pdk/nrf54h20pdk_nrf54h20_enga_cpuapp_defconfig
```kconfig
# Copyright (c) 2024 Nordic Semiconductor ASA
# SPDX-License-Identifier: Apache-2.0

# Enable GPIO
CONFIG_GPIO=y
```

## boards/nordic_nrf/nrf54h20pdk/nrf54h20pdk_nrf54h20_enga_cpuppr_defconfig
```kconfig
# Copyright (c) 2024 Nordic Semiconductor ASA
# SPDX-License-Identifier: Apache-2.0

CONFIG_XIP=n

# Enable UART driver
CONFIG_SERIAL=y

# Enable console
CONFIG_CONSOLE=y
CONFIG_UART_CONSOLE=y
```

## boards/nordic_nrf/nrf9160dk/Kconfig.nrf9160dk
```kconfig
# nRF9160 DK NRF9160 board configuration

# Copyright (c) 2018-2020 Nordic Semiconductor ASA
# SPDX-License-Identifier: Apache-2.0

config BOARD_NRF9160DK
	select SOC_NRF9160_SICA if BOARD_NRF9160DK_NRF9160 || BOARD_NRF9160DK_NRF9160_NS
	select SOC_NRF52840_QIAA if BOARD_NRF9160DK_NRF52840
	# The GPIO driver is required by this board's initialization code
	# (board.c), so it is forced here to be enabled always, not only
	# enabled by default (in defconfig).
	select GPIO if BOARD_NRF9160DK_NRF52840
```

## boards/v2/arduino/arduino_nano_33_ble/Kconfig.arduino_nano_33_ble
```kconfig
# Copyright (c) 2020 Jefferson Lee.
# SPDX-License-Identifier: Apache-2.0

config BOARD_ARDUINO_NANO_33_BLE
	bool
	default y
	select SOC_NRF52840_QIAA
```

## boards/v2/arduino/arduino_nano_33_ble/board.yml
```yaml
board:
  name: arduino_nano_33_ble
  vendor: Arduino
  variants:
  - name: 'sense'
```

## boards/v2/arm/mps3/Kconfig
```kconfig
# Copyright (c) 2021 Linaro Limited
# SPDX-License-Identifier: Apache-2.0

config BOARD_MPS3_AN547
	select QEMU_TARGET
```

## boards/v2/arm/mps3/Kconfig.mps3
```kconfig
# Copyright (c) 2023 Nordic Semiconductor
#
# SPDX-License-Identifier: Apache-2.0

config BOARD_MPS3_AN547
	bool
	default y
	select SOC_MPS3_AN547
	help
	  Arm Cortex-M55 (Corstone-300, SSE-300 w/Ethos-U55) on MPS3 (AN547)
```

## boards/v2/contextual_electronics/contextualelectronics_abc/Kconfig.contextualelectronics_abc
```kconfig
# ABC board configuration

# Copyright (c) 2020 Analog Life LLC
# SPDX-License-Identifier: Apache-2.0

config BOARD_CONTEXTELEC_ABC
	select SOC_NRF52840_QIAA
```

## boards/v2/ebyte/ebyte_e73_tbb/board.yml
```yaml
board:
  name: ebyte_e73_tbb
  vendor: Chengdu Ebyte Electronic Technology Co.
  socs:
  - name: nrf52832
```

## boards/v2/laird_connect/bl5340_dvk/Kconfig.bl5340_dvk
```kconfig
# BL5340-DVK board configuration

# Copyright (c) 2021 Laird Connectivity
# SPDX-License-Identifier: Apache-2.0

config BOARD_BL5340_DVK
	select SOC_NRF5340_CPUAPP_QKAA if "$(BOARD_IDENTIFIER)" = "/nrf5340/cpuapp"
	select SOC_NRF5340_CPUAPP_QKAA if "$(BOARD_IDENTIFIER)" = "/nrf5340/cpuapp/ns"
	select SOC_NRF5340_CPUNET_QKAA if "$(BOARD_IDENTIFIER)" = "/nrf5340/cpunet"
```
