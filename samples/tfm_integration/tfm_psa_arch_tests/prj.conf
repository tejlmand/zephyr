## CMakeLists.txt
```
# SPDX-License-Identifier: Apache-2.0

cmake_minimum_required(VERSION 3.13.1)

include($ENV{ZEPHYR_BASE}/cmake/app/boilerplate.cmake NO_POLICY_SCOPE)

include(${CMAKE_CURRENT_SOURCE_DIR}/../CMakeLists.inc)

project(tfm_ipc)

set (TFM_ROOT_PATH $ENV{ZEPHYR_BASE}/../modules/tfm/trusted-firmware-m)

target_sources(app PRIVATE src/main.c)

# Make sure we are using a compatible board target.
if((${BOARD} STREQUAL "mps2_an521_nonsecure"))
	set(PSA_ARCH_TESTS_BOARD "tgt_dev_apis_tfm_an521")
elseif((${BOARD} STREQUAL "v2m_musca_b1_nonsecure"))
	set(PSA_ARCH_TESTS_BOARD "tgt_dev_apis_tfm_musca_b1")
else()
        message(FATAL_ERROR "${BOARD} unsupported. Please use \'${ZEPHYRBOARD}\'.")
endif()

if(${CONFIG_PSA_ARCH_API_TEST})
	set(TFMCONFIG "ConfigPsaApiTestIPC")
	if(${CONFIG_PSA_API_TEST_SUITE} STREQUAL "crypto")
		set(PSA_API_TEST_SUITE "-DPSA_API_TEST_CRYPTO=ON")
	elseif(${CONFIG_PSA_API_TEST_SUITE} STREQUAL "protected_storage")
		set(PSA_API_TEST_SUITE "-DPSA_API_TEST_SECURE_STORAGE=ON")
	elseif(${CONFIG_PSA_API_TEST_SUITE} STREQUAL "initial_attestation")
		set(PSA_API_TEST_SUITE "-DPSA_API_TEST_ATTESTATION=ON")
	endif()
else()
	set(TFMCONFIG "ConfigRegressionIPC")
endif()

# Set an ARM toolchain path for the CI docker image
set(TFM_CI_ARM "export PATH=$PATH:/opt/toolchain/arm-none-eabi/bin")

# Build psa-arch-tests before TF-M
if(${CONFIG_PSA_ARCH_API_TEST})
	if(NOT EXISTS ${TFM_REMOTE_DIR}/psa-arch-tests)
		remote_exec(${TFM_GIT_PSA_ARCH_TESTS})
	endif()

	set(psa_arch_test_cmd "${TFM_REMOTE_DIR}/psa-arch-tests/api-tests/tools/scripts/setup.sh --target ${PSA_ARCH_TESTS_BOARD} --toolchain GNUARM --cpu_arch armv8m_ml --verbose 3 --suite ${CONFIG_PSA_API_TEST_SUITE} --include ${TFM_BASE}/interface/include --source ${TFM_REMOTE_DIR}/psa-arch-tests/api-tests --archive_tests")
        execute_process(
                # TODO: Only prepend path in CI environment
                COMMAND bash -c "${TFM_CI_ARM}; ${psa_arch_test_cmd}"
                WORKING_DIRECTORY  ${TFM_REMOTE_DIR}/psa-arch-tests/api-tests
                OUTPUT_VARIABLE PROCESS_OUTPUT
                OUTPUT_STRIP_TRAILING_WHITESPACE)
        message("${PROCESS_OUTPUT}")
endif()

if(${CONFIG_PSA_ARCH_API_TEST})
  set(PSA_API_TEST_BUILD_PATH ${TFM_ROOT_PATH}/../psa-arch-tests/api-tests/BUILD)
  target_include_directories(app PRIVATE $ENV{ZEPHYR_BASE}/include/cmsis_rtos_v2)
  target_include_directories(app PRIVATE ${TFM_ROOT_PATH}/lib/ext/qcbor/inc)

  target_sources(app PRIVATE ${TFM_ROOT_PATH}/app/os_wrapper_cmsis_rtos_v2.c)

  target_sources(app PRIVATE ${TFM_ROOT_PATH}/interface/src/tfm_psa_ns_api.c)
  target_sources(app PRIVATE ${TFM_ROOT_PATH}/interface/src/tfm_ns_interface.c)
  target_sources(app PRIVATE ${TFM_ROOT_PATH}/interface/src/tfm_crypto_ipc_api.c)
  target_sources(app PRIVATE ${TFM_ROOT_PATH}/interface/src/tfm_sst_ipc_api.c)
  target_sources(app PRIVATE ${TFM_ROOT_PATH}/interface/src/tfm_initial_attestation_ipc_api.c)

  target_sources(app PRIVATE ${TFM_ROOT_PATH}/lib/ext/qcbor/src/ieee754.c)
  target_sources(app PRIVATE ${TFM_ROOT_PATH}/lib/ext/qcbor/src/qcbor_decode.c)
  target_sources(app PRIVATE ${TFM_ROOT_PATH}/lib/ext/qcbor/src/qcbor_encode.c)
  target_sources(app PRIVATE ${TFM_ROOT_PATH}/lib/ext/qcbor/src/UsefulBuf.c)

  target_link_libraries(${ZEPHYR_CURRENT_LIBRARY} PRIVATE
    "${PSA_API_TEST_BUILD_PATH}/val/val_nspe.a"
  )
  target_link_libraries(${ZEPHYR_CURRENT_LIBRARY} PRIVATE
    "${PSA_API_TEST_BUILD_PATH}/platform/pal_nspe.a"
  )

  target_link_libraries(${ZEPHYR_CURRENT_LIBRARY} PRIVATE
    "${PSA_API_TEST_BUILD_PATH}/dev_apis/${CONFIG_PSA_API_TEST_SUITE}/test_combine.a"
  )
endif()

target_include_directories(app PRIVATE
  ${TFM_ROOT_PATH}/interface/include
  )

target_link_libraries(${ZEPHYR_CURRENT_LIBRARY} PRIVATE
  ${TFM_ROOT_PATH}/build/install/export/tfm/veneers/s_veneers.o
  )

target_compile_definitions(app PRIVATE
  -DTFM_PSA_API
  )
target_compile_definitions(app PRIVATE
  -DTFM_PARTITION_TEST_CORE_IPC
  )
```

## sample.yaml
```
sample:
  description: TF-M psa-arch-tests sample
    application
  name: TF-M PSA ARCH TESTS
tests:
  sample.tfm_ipc:
    tags: introduction
    platform_whitelist: mps2_an521_nonsecure
```

## prj.conf
```kconfig
CONFIG_BUILD_WITH_TFM=y

# ipc, crypto, protected_storage, internal_trusted_storage, initial_attestation
CONFIG_PSA_ARCH_TEST_SUITE="ipc"

CONFIG_CMSIS_RTOS_V2=y
CONFIG_NUM_PREEMPT_PRIORITIES=56
CONFIG_HEAP_MEM_POOL_SIZE=1024
CONFIG_POLL=y
CONFIG_THREAD_NAME=y
CONFIG_THREAD_STACK_INFO=y
CONFIG_THREAD_MONITOR=y
CONFIG_IRQ_OFFLOAD=y
CONFIG_INIT_STACKS=y
CONFIG_MAX_THREAD_BYTES=4
CONFIG_SCHED_SCALABLE=y
CONFIG_CMSIS_V2_MEM_SLAB_MAX_DYNAMIC_SIZE=128
CONFIG_CMSIS_V2_THREAD_MAX_COUNT=23
CONFIG_CMSIS_V2_THREAD_DYNAMIC_MAX_COUNT=10

# The Zephyr CMSIS emulation assumes that ticks are ms, currently
CONFIG_SYS_CLOCK_TICKS_PER_SEC=1000

CONFIG_MAIN_STACK_SIZE=4096
CONFIG_HEAP_MEM_POOL_SIZE=4096
```

## src/main.c
```c
/*
 * Copyright (c) 2019 Linaro Limited
 *
 * SPDX-License-Identifier: Apache-2.0
 */

#include <zephyr.h>
#include <sys/printk.h>
#include "cmsis_os2.h"
#include "tfm_ns_interface.h"

/**
 * \brief This symbol is the entry point provided by the PSA API compliance
 *        test libraries
 */
extern void val_entry(void);

static u64_t test_app_stack[(3u * 1024u) / (sizeof(u64_t))];
static const osThreadAttr_t thread_attr = {
	.name = "test_thread",
	.stack_mem = test_app_stack,
	.stack_size = sizeof(test_app_stack),
};

static osStatus_t     status;
static osThreadId_t   thread_id;
static osThreadFunc_t thread_func;

void main(void)
{
	/* Initialize the TFM NS interface */
	tfm_ns_interface_init();

	thread_func = (osThreadFunc_t)val_entry;
	thread_id = osThreadNew(thread_func, NULL, &thread_attr);

	(void)status;
	(void)thread_id;
	(void)thread_func;

	printk("TF-M PSA Arch Tests with Zephyr on %s\n", CONFIG_BOARD);
}
```
