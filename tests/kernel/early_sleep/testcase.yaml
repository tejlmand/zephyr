## tests/kernel/early_sleep/testcase.yaml
```yaml
tests:
  kernel.common.sleep:
    tags: kernel sleep
  kernel.common.sleep.linker_generator:
    arch_allow: arm
    tags: kernel sleep linker_generator
    extra_configs:
      - CONFIG_CMAKE_LINKER_GENERATOR=y
```

## tests/kernel/fifo/fifo_api/testcase.yaml
```yaml
tests:
  kernel.fifo:
    tags: kernel
  kernel.fifo.linker_generator:
    arch_allow: arm
    tags: kernel linker_generator
    extra_configs:
      - CONFIG_CMAKE_LINKER_GENERATOR=y
```

## tests/kernel/fifo/fifo_timeout/testcase.yaml
```yaml
tests:
  kernel.fifo.timeout:
    tags: kernel
  kernel.fifo.timeout.linker_generator:
    arch_allow: arm
    tags: kernel linker_generator
    extra_configs:
      - CONFIG_CMAKE_LINKER_GENERATOR=y
```

## tests/kernel/fifo/fifo_usage/testcase.yaml
```yaml
tests:
  kernel.fifo.usage:
    tags: kernel
  kernel.fifo.usage.linker_generator:
    arch_allow: arm
    tags: kernel linker_generator
    extra_configs:
      - CONFIG_CMAKE_LINKER_GENERATOR=y
```

## tests/kernel/interrupt/testcase.yaml
```yaml
tests:
  arch.interrupt:
    # nios2 excluded, see #22956
    arch_exclude: nios2 x86
    tags: kernel interrupt
    filter: not CONFIG_TRUSTED_EXECUTION_NONSECURE

  arch.interrupt.x86_64:
    arch_allow: x86
    tags: kernel interrupt
    filter: CONFIG_X86_64

  arch.interrupt.x86:
    arch_allow: x86
    tags: kernel interrupt
    filter: not CONFIG_X86_64
    extra_configs:
    - CONFIG_COMPILER_OPT="-mgeneral-regs-only"

  arch.interrupt.linker_generator:
    arch_allow: arm
    platform_exclude: qemu_cortex_r5
    tags: kernel interrupt linker_generator
    filter: not CONFIG_TRUSTED_EXECUTION_NONSECURE
    extra_configs:
      - CONFIG_CMAKE_LINKER_GENERATOR=y
```

## tests/kernel/mbox/mbox_api/testcase.yaml
```yaml
tests:
  kernel.mailbox.api:
    tags: kernel
  kernel.mailbox.api.linker_generator:
    arch_allow: arm
    tags: kernel linker_generator
    extra_configs:
      - CONFIG_CMAKE_LINKER_GENERATOR=y
```

## tests/kernel/mbox/mbox_usage/testcase.yaml
```yaml
tests:
  kernel.mailbox.usage:
    tags: kernel
  kernel.mailbox.usage.linker_generator:
    arch_allow: arm
    tags: kernel linker_generator
    extra_configs:
      - CONFIG_CMAKE_LINKER_GENERATOR=y
```

## tests/kernel/mem_heap/k_heap_api/testcase.yaml
```yaml
tests:
  kernel.k_heap_api:
    tags: k_heap_api kernel
  kernel.k_heap_api.linker_generator:
    arch_allow: arm
    tags: k_heap_api kernel linker_generator
    extra_configs:
      - CONFIG_CMAKE_LINKER_GENERATOR=y
```

## tests/kernel/mem_protect/futex/testcase.yaml
```yaml
tests:
  kernel.futex:
    filter: CONFIG_ARCH_HAS_USERSPACE
    tags: kernel userspace
  kernel.futex.linker_generator:
    arch_allow: arm
    filter: CONFIG_ARCH_HAS_USERSPACE
    tags: kernel userspace linker_generator
    extra_configs:
      - CONFIG_CMAKE_LINKER_GENERATOR=y
```

## tests/kernel/mem_protect/sys_sem/testcase.yaml
```yaml
tests:
  kernel.memory_protection.sys_sem:
    tags: kernel userspace
  kernel.memory_protection.sys_sem.linker_generator:
    arch_allow: arm
    tags: kernel userspace linker_generator
    extra_configs:
      - CONFIG_CMAKE_LINKER_GENERATOR=y
  kernel.memory_protection.sys_sem.nouser:
    tags: kernel
    extra_configs:
      - CONFIG_TEST_USERSPACE=n
```

## tests/kernel/mem_protect/syscalls/testcase.yaml
```yaml
tests:
  kernel.memory_protection.syscalls:
    filter: CONFIG_ARCH_HAS_USERSPACE
    tags: kernel security userspace ignore_faults
  kernel.memory_protection.syscalls.linker_generator:
    arch_allow: arm
    filter: CONFIG_ARCH_HAS_USERSPACE
    tags: kernel security userspace ignore_faults linker_generator
    extra_configs:
      - CONFIG_CMAKE_LINKER_GENERATOR=y
```

## tests/kernel/mem_slab/mslab/testcase.yaml
```yaml
tests:
  kernel.memory_slabs.api:
    tags: kernel
  kernel.memory_slabs.api.linker_generator:
    arch_allow: arm
    tags: kernel linker_generator
    extra_configs:
      - CONFIG_CMAKE_LINKER_GENERATOR=y
```

## tests/kernel/mem_slab/mslab_concept/testcase.yaml
```yaml
tests:
  kernel.memory_slabs.concept:
    tags: kernel
  kernel.memory_slabs.concept.linker_generator:
    arch_allow: arm
    tags: kernel linker_generator
    extra_configs:
      - CONFIG_CMAKE_LINKER_GENERATOR=y
```

## tests/kernel/mp/testcase.yaml
```yaml
tests:
  kernel.multiprocessing:
    tags: kernel smp
    filter: CONFIG_MP_NUM_CPUS > 1
  kernel.multiprocessing.linker_generator:
    arch_allow: arm
    tags: kernel smp linker_generator
    filter: CONFIG_MP_NUM_CPUS > 1
    extra_configs:
      - CONFIG_CMAKE_LINKER_GENERATOR=y
```

## tests/kernel/msgq/msgq_api/testcase.yaml
```yaml
tests:
  kernel.message_queue:
    tags: kernel userspace
  kernel.message_queue.linker_generator:
    arch_allow: arm
    tags: kernel userspace linker_generator
    extra_configs:
      - CONFIG_CMAKE_LINKER_GENERATOR=y
```

## tests/kernel/msgq/msgq_usage/testcase.yaml
```yaml
tests:
  kernel.message_queue_usage:
    tags: kernel
  kernel.message_queue_usage.linker_generator:
    arch_allow: arm
    tags: kernel linker_generator
    extra_configs:
      - CONFIG_CMAKE_LINKER_GENERATOR=y
```

## tests/kernel/mutex/mutex_api/testcase.yaml
```yaml
tests:
  kernel.mutex:
    tags: kernel userspace
  kernel.mutex.linker_generator:
    arch_allow: arm
    tags: kernel userspace linker_generator
    extra_configs:
      - CONFIG_CMAKE_LINKER_GENERATOR=y
```

## tests/kernel/mutex/mutex_error_case/testcase.yaml
```yaml
tests:
  kernel.mutex:
    filter: CONFIG_ARCH_HAS_USERSPACE
    tags: kernel userspace ignore_faults
  kernel.mutex.linker_generator:
    arch_allow: arm
    filter: CONFIG_ARCH_HAS_USERSPACE
    tags: kernel userspace ignore_faults linker_generator
    extra_configs:
      - CONFIG_CMAKE_LINKER_GENERATOR=y
```

## tests/kernel/mutex/sys_mutex/testcase.yaml
```yaml
tests:
  system.mutex:
    filter: CONFIG_ARCH_HAS_USERSPACE
    tags: kernel userspace
  system.mutex.nouser:
    tags: kernel
    extra_configs:
      - CONFIG_TEST_USERSPACE=n
  system.mutex.linker_generator:
    arch_allow: arm
    filter: CONFIG_ARCH_HAS_USERSPACE
    tags: kernel userspace linker_generator
    extra_configs:
      - CONFIG_CMAKE_LINKER_GENERATOR=y
```

## tests/kernel/pending/testcase.yaml
```yaml
tests:
  kernel.objects:
    tags: kernel
  kernel.objects.linker_generator:
    arch_allow: arm
    tags: kernel linker_generator
    extra_configs:
      - CONFIG_CMAKE_LINKER_GENERATOR=y
```

## tests/kernel/pipe/pipe/testcase.yaml
```yaml
tests:
  kernel.pipe:
      tags: kernel userspace ignore_faults
  kernel.pipe.linker_generator:
      arch_allow: arm
      tags: kernel userspace ignore_faults linker_generator
      extra_configs:
          - CONFIG_CMAKE_LINKER_GENERATOR=y
```

## tests/kernel/poll/testcase.yaml
```yaml
tests:
  kernel.poll:
    tags: kernel userspace ignore_faults
    platform_exclude: nrf52dk_nrf52810
  kernel.poll.linker_generator:
    arch_allow: arm
    tags: kernel userspace ignore_faults linker_generator
    platform_exclude: nrf52dk_nrf52810
    extra_configs:
      - CONFIG_CMAKE_LINKER_GENERATOR=y
```

## tests/kernel/queue/testcase.yaml
```yaml
tests:
  kernel.queue:
    tags: kernel userspace ignore_faults
  kernel.queue.linker_generator:
    arch_allow: arm
    tags: kernel userspace ignore_faults linker_generator
    extra_configs:
      - CONFIG_CMAKE_LINKER_GENERATOR=y
```

## tests/kernel/sched/deadline/testcase.yaml
```yaml
tests:
  kernel.scheduler.deadline:
    tags: kernel
  kernel.scheduler.deadline.linker_generator:
    arch_allow: arm
    tags: kernel linker_generator
    extra_configs:
      - CONFIG_CMAKE_LINKER_GENERATOR=y
```

## tests/kernel/sched/metairq/testcase.yaml
```yaml
tests:
  kernel.scheduler.metairq:
    tags: kernel
    filter: not CONFIG_SMP
    platform_exclude: nrf52dk_nrf52810
  kernel.scheduler.metairq.linker_generator:
    arch_allow: arm
    tags: kernel linker_generator
    filter: not CONFIG_SMP
    platform_exclude: nrf52dk_nrf52810
    extra_configs:
      - CONFIG_CMAKE_LINKER_GENERATOR=y
```
