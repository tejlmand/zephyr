## tests/kernel/sched/preempt/testcase.yaml
```yaml
tests:
  kernel.scheduler.preempt:
    tags: kernel
    filter: not CONFIG_SMP
    platform_exclude: nrf52dk_nrf52810
  kernel.scheduler.preempt.linker_generator:
    arch_allow: arm
    tags: kernel linker_generator
    filter: not CONFIG_SMP
    platform_exclude: nrf52dk_nrf52810
    extra_configs:
      - CONFIG_CMAKE_LINKER_GENERATOR=y
```

## tests/kernel/semaphore/semaphore/testcase.yaml
```yaml
tests:
  kernel.semaphore:
    tags: kernel userspace ignore_faults
  kernel.semaphore.linker_generator:
    arch_allow: arm
    tags: kernel userspace ignore_faults linker_generator
    extra_configs:
      - CONFIG_CMAKE_LINKER_GENERATOR=y
```

## tests/kernel/semaphore/sys_sem/testcase.yaml
```yaml
tests:
  kernel.semaphore.usage:
    filter: CONFIG_ARCH_HAS_USERSPACE
    tags: kernel userspace ignore_faults
  kernel.semaphore.usage.linker_generator:
    arch_allow: arm
    filter: CONFIG_ARCH_HAS_USERSPACE
    tags: kernel userspace ignore_faults linker_generator
    extra_configs:
      - CONFIG_CMAKE_LINKER_GENERATOR=y
```

## tests/kernel/sleep/testcase.yaml
```yaml
tests:
  kernel.common.timing.linker_generator:
    arch_allow: arm
    tags: kernel sleep linker_generator
    extra_configs:
      - CONFIG_CMAKE_LINKER_GENERATOR=y
```

## tests/kernel/smp/testcase.yaml
```yaml
tests:
  kernel.multiprocessing.smp:
    tags: kernel smp ignore_faults
    filter: (CONFIG_MP_NUM_CPUS > 1)
  kernel.multiprocessing.smp.linker_generator:
    arch_allow: arm
    extra_configs:
      - CONFIG_TIMESLICING=y
      - CONFIG_CMAKE_LINKER_GENERATOR=y
    tags: kernel smp ignore_faults linker_generator
    filter: (CONFIG_MP_NUM_CPUS > 1)
```

## tests/kernel/stack/stack/testcase.yaml
```yaml
tests:
  kernel.stack.usage:
    tags: kernel userspace ignore_faults
  kernel.stack.usage.linker_generator:
    arch_allow: arm
    tags: kernel userspace ignore_faults linker_generator
    extra_configs:
      - CONFIG_CMAKE_LINKER_GENERATOR=y
```

## tests/kernel/threads/dynamic_thread/testcase.yaml
```yaml
tests:
  kernel.threads.dynamic:
    tags: kernel threads userspace ignore_faults
    filter: CONFIG_ARCH_HAS_USERSPACE
    arch_exclude: x86 # see GitHub #17893
  kernel.threads.dynamic.linker_generator:
    arch_allow: arm
    tags: kernel threads userspace ignore_faults linker_generator
    filter: CONFIG_ARCH_HAS_USERSPACE
    extra_configs:
      - CONFIG_CMAKE_LINKER_GENERATOR=y
```

## tests/kernel/threads/no-multithreading/testcase.yaml
```yaml
tests:
  kernel.threads.no-multithreading:
    tags: kernel
    filter: not CONFIG_SMP
    platform_allow: qemu_cortex_m0 qemu_cortex_m3 mps2_an385 mps2_an521
      nrf52840dk_nrf52840 nrf9160dk_nrf9160 nrf51dk_nrf51422
  kernel.threads.no-multithreading.linker_generator:
    arch_allow: arm
    tags: kernel
    filter: not CONFIG_SMP
    platform_allow: qemu_cortex_m0 qemu_cortex_m3 mps2_an385 mps2_an521
      nrf52840dk_nrf52840 nrf9160dk_nrf9160 nrf51dk_nrf51422
    extra_configs:
      - CONFIG_CMAKE_LINKER_GENERATOR=y
```

## tests/kernel/threads/thread_apis/testcase.yaml
```yaml
tests:
  kernel.threads.apis:
    tags: kernel threads userspace ignore_faults
    min_flash: 34
  kernel.threads.apis.linker_generator:
    arch_allow: arm
    tags: kernel threads userspace ignore_faults linker_generator
    min_flash: 34
    extra_configs:
      - CONFIG_CMAKE_LINKER_GENERATOR=y
```

## tests/kernel/threads/thread_error_case/testcase.yaml
```yaml
tests:
  kernel.threads.error.case:
    tags: kernel threads userspace ignore_faults
    filter: CONFIG_USERSPACE
  kernel.threads.error.case.linker_generator:
    arch_allow: arm
    tags: kernel threads userspace ignore_faults linker_generator
    filter: CONFIG_USERSPACE
    extra_configs:
      - CONFIG_CMAKE_LINKER_GENERATOR=y
```

## tests/kernel/threads/thread_init/testcase.yaml
```yaml
tests:
  kernel.threads.init:
    tags: kernel threads userspace
  kernel.threads.init.linker_generator:
    arch_allow: arm
    tags: kernel threads userspace linker_generator
    extra_configs:
      - CONFIG_CMAKE_LINKER_GENERATOR=y
```

## tests/kernel/threads/thread_stack/testcase.yaml
```yaml
tests:
  kernel.threads.thread_stack:
    tags: kernel security userspace ignore_faults
    min_ram: 16
  kernel.threads.armv8m_mpu_stack_guard:
    min_ram: 16
    extra_args: CONF_FILE=prj_armv8m_mpu_stack_guard.conf
    filter: CONFIG_ARM_MPU and CONFIG_ARMV8_M_MAINLINE
    arch_allow: arm
    tags: kernel security userspace ignore_faults
  kernel.threads.thread_stack.linker_generator:
    arch_allow: arm
    tags: kernel security userspace ignore_faults linker_generator
    min_ram: 16
    extra_configs:
      - CONFIG_CMAKE_LINKER_GENERATOR=y
```

## tests/kernel/timer/starve/testcase.yaml
```yaml
tests:
  kernel.timer.starve:
    build_only: true
    tags: kernel timer
  kernel.timer.starve.linker_generator:
    arch_allow: arm
    build_only: true
    tags: kernel timer linker_generator
    extra_configs:
      - CONFIG_CMAKE_LINKER_GENERATOR=y
```

## tests/kernel/timer/timer_api/testcase.yaml
```yaml
tests:
  kernel.timer:
    tags: kernel timer userspace
  kernel.timer.tickless:
    extra_args: CONF_FILE="prj_tickless.conf"
    arch_exclude: nios2 posix
    platform_exclude: litex_vexriscv rv32m1_vega_zero_riscy rv32m1_vega_ri5cy
      nrf5340dk_nrf5340_cpunet
    tags: kernel timer userspace
  kernel.timer.no_multitheading:
    tags: kernel timer
    platform_allow: qemu_cortex_m3
    extra_configs:
      - CONFIG_MULTITHREADING=n
      - CONFIG_TEST_USERSPACE=n
      - CONFIG_SPIN_VALIDATE=n
  kernel.timer.linker_generator:
    arch_allow: arm
    tags: kernel timer userspace linker_generator
    extra_configs:
      - CONFIG_CMAKE_LINKER_GENERATOR=y
```

## tests/kernel/timer/timer_error_case/testcase.yaml
```yaml
tests:
  kernel.timer:
    tags: kernel timer userspace ignore_faults
  kernel.timer.linker_generator:
    arch_allow: arm
    tags: kernel timer userspace ignore_faults linker_generator
    extra_configs:
      - CONFIG_CMAKE_LINKER_GENERATOR=y
```

## tests/kernel/timer/timer_monotonic/testcase.yaml
```yaml
tests:
  kernel.timer.monotonic:
    tags: kernel timer
  kernel.timer.monotonic.linker_generator:
    arch_allow: arm
    tags: kernel timer linker_generator
    extra_configs:
      - CONFIG_CMAKE_LINKER_GENERATOR=y
```

## tests/kernel/workq/user_work/testcase.yaml
```yaml
tests:
  kernel.work.user:
    min_flash: 34
    filter: CONFIG_ARCH_HAS_USERSPACE
    tags: kernel userspace
  kernel.work.user.linker_generator:
    arch_allow: arm
    min_flash: 34
    filter: CONFIG_ARCH_HAS_USERSPACE
    tags: kernel userspace linker_generator
    extra_configs:
      - CONFIG_CMAKE_LINKER_GENERATOR=y
```

## tests/kernel/workq/work/testcase.yaml
```yaml
tests:
  kernel.work.api:
    min_flash: 34
    tags: kernel
  kernel.work.api.linker_generator:
    arch_allow: arm
    min_flash: 34
    tags: kernel linker_generator
    extra_configs:
      - CONFIG_CMAKE_LINKER_GENERATOR=y
```

## tests/kernel/workq/work_queue/testcase.yaml
```yaml
tests:
  kernel.workqueue:
    min_flash: 34
    tags: kernel
  kernel.workqueue.linker_generator:
    arch_allow: arm
    min_flash: 34
    tags: kernel linker_generator
    extra_configs:
      - CONFIG_CMAKE_LINKER_GENERATOR=y
```

## tests/kernel/xip/testcase.yaml
```yaml
tests:
  arch.common.xip:
    filter: CONFIG_XIP
    tags: kernel xip
  arch.common.xip.linker_generator:
    arch_allow: arm
    filter: CONFIG_XIP
    tags: kernel xip linker_generator
    extra_configs:
      - CONFIG_CMAKE_LINKER_GENERATOR=y
```

## west.yml
```yaml
# The default West manifest file to be used for Zephyr.

west:
  url: https://github.com/tejlmand/west
  revision: feature_west_update_rework

manifest:
  defaults:
    remote: upstream-zephyr
    revision: master

  remotes:
    - name: upstream-zephyr
      url-base: https://github.com/zephyrproject-rtos
    - name: upstream-mcuboot
      url-base: https://github.com/JuulLabs-OSS


  projects:
    - name: mcuboot
      remote: upstream-mcuboot
      revision: master

  self:
    path: zephyr
```
